#include "oled_ssd1306.h"

#include <stdbool.h>
#include <stddef.h>
#include <string.h>

#include "driver/i2c_master.h"
#include "esp_log.h"
#include "freertos/FreeRTOS.h"
#include "freertos/task.h"
#include "gpio_config.h"

#define OLED_I2C_SPEED_HZ 100000
#define OLED_TIMEOUT_MS 40

static const char *TAG = "OLED_SSD1306";
static i2c_master_bus_handle_t bus;
static i2c_master_dev_handle_t device;
static bool ready;
static uint8_t current_address;

// Printable ASCII 0x20..0x7E. Five vertical columns, bit 0 at the top.
static const uint8_t font5x7[][5] = {
    {0x00, 0x00, 0x00, 0x00, 0x00}, // space
    {0x00, 0x00, 0x5F, 0x00, 0x00}, // !
    {0x00, 0x07, 0x00, 0x07, 0x00}, // double quote
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    {0x08, 0x04, 0x08, 0x10, 0x08}, // ~
};

_Static_assert(sizeof(font5x7) / sizeof(font5x7[0]) == 95, "ASCII font size mismatch");
_Static_assert(OLED_SSD1306_TEXT_COLUMNS * 6 <= OLED_SSD1306_WIDTH, "Text exceeds width");

static void release_bus(void)
{
    ready = false;
    current_address = 0;
    if (device != NULL) {
        i2c_master_bus_rm_device(device);
        device = NULL;
    }
    if (bus != NULL) {
        i2c_del_master_bus(bus);
        bus = NULL;
    }
}

static esp_err_t find_address(uint8_t *address)
{
    unsigned found = 0;
    for (uint8_t candidate = 0x3C; candidate <= 0x3D; ++candidate) {
        esp_err_t ret = i2c_master_probe(bus, candidate, OLED_TIMEOUT_MS);
        if (ret == ESP_OK) {
            *address = candidate;
            ++found;
            ESP_LOGI(TAG, "I2C device found: 0x%02X", candidate);
        } else if (ret != ESP_ERR_NOT_FOUND) {
            return ret;
        }
    }
    if (found == 0) {
        ESP_LOGE(TAG, "No device at 0x3C/0x3D; check OLED power and SDA/SCL");
        return ESP_ERR_NOT_FOUND;
    }
    if (found > 1) {
        ESP_LOGE(TAG, "Both addresses respond; set the OLED address explicitly");
        return ESP_ERR_INVALID_STATE;
    }
    return ESP_OK;
}

static esp_err_t write_page(uint8_t page, const uint8_t data[OLED_SSD1306_WIDTH + 1])
{
    // Control byte 0x00, page, lower column, upper column.
    const uint8_t commands[] = {0x00, (uint8_t)(0xB0 | page), 0x00, 0x10};
    esp_err_t ret = i2c_master_transmit(device, commands, sizeof(commands), OLED_TIMEOUT_MS);
    if (ret != ESP_OK) {
        return ret;
    }
    return i2c_master_transmit(device, data, OLED_SSD1306_WIDTH + 1, OLED_TIMEOUT_MS);
}

esp_err_t oled_ssd1306_init(uint8_t address)
{
    if (ready) {
        return address == 0 || address == current_address ? ESP_OK : ESP_ERR_INVALID_STATE;
    }
    if (address != 0 && address != 0x3C && address != 0x3D) {
        return ESP_ERR_INVALID_ARG;
    }
    const i2c_master_bus_config_t bus_config = {
        .i2c_port = I2C_NUM_0,
        .sda_io_num = GPIO_OLED_SDA,
        .scl_io_num = GPIO_OLED_SCL,
        .clk_source = I2C_CLK_SRC_DEFAULT,
        .glitch_ignore_cnt = 7,
        .flags.enable_internal_pullup = true,
    };
    esp_err_t ret = i2c_new_master_bus(&bus_config, &bus);
    if (ret != ESP_OK) {
        return ret;
    }
    vTaskDelay(pdMS_TO_TICKS(100));
    ret = address == 0 ? find_address(&address)
                       : i2c_master_probe(bus, address, OLED_TIMEOUT_MS);
    if (ret != ESP_OK) {
        goto fail;
    }
    const i2c_device_config_t device_config = {
        .dev_addr_length = I2C_ADDR_BIT_LEN_7,
        .device_address = address,
        .scl_speed_hz = OLED_I2C_SPEED_HZ,
    };
    ret = i2c_master_bus_add_device(bus, &device_config, &device);
    if (ret != ESP_OK) {
        goto fail;
    }
    const uint8_t init_commands[] = {
        0x00,       // I2C control byte for command stream
        0xAE,       // Display off during initialization
        0xD5, 0x80, // Clock
        0xA8, 0x3F, // Multiplex for 64 rows
        0xD3, 0x00, // Display offset
        0x40,       // Start line 0
        0x8D, 0x14, // Internal charge pump
        0x20, 0x02, // Page addressing mode
        0xA1,       // Segment remap
        0xC8,       // COM scan direction
        0xDA, 0x12, // COM hardware configuration for 128x64
        0x81, 0x7F, // Contrast
        0xD9, 0xF1, // Precharge
        0xDB, 0x40, // VCOMH
        0xA4,       // Display follows RAM
        0xA6,       // Normal pixels
        0x2E,       // Stop scrolling
    };
    ret = i2c_master_transmit(device, init_commands, sizeof(init_commands), OLED_TIMEOUT_MS);
    if (ret != ESP_OK) {
        goto fail;
    }
    const uint8_t blank[OLED_SSD1306_WIDTH + 1] = {0x40};
    for (uint8_t page = 0; page < OLED_SSD1306_PAGES; ++page) {
        ret = write_page(page, blank);
        if (ret != ESP_OK) {
            goto fail;
        }
    }
    const uint8_t display_on[] = {0x00, 0xAF};
    ret = i2c_master_transmit(device, display_on, sizeof(display_on), OLED_TIMEOUT_MS);
    if (ret != ESP_OK) {
        goto fail;
    }
    ready = true;
    current_address = address;
    ESP_LOGI(TAG, "OLED 128x64 ready: address=0x%02X SDA=%d SCL=%d",
             address, GPIO_OLED_SDA, GPIO_OLED_SCL);
    return ESP_OK;

fail:
    release_bus();
    return ret;
}

esp_err_t oled_ssd1306_clear(void)
{
    if (!ready) {
        return ESP_ERR_INVALID_STATE;
    }
    const uint8_t blank[OLED_SSD1306_WIDTH + 1] = {0x40};
    for (uint8_t page = 0; page < OLED_SSD1306_PAGES; ++page) {
        esp_err_t ret = write_page(page, blank);
        if (ret != ESP_OK) {
            return ret;
        }
    }
    return ESP_OK;
}

esp_err_t oled_ssd1306_write_line(uint8_t page, const char *text)
{
    if (!ready) {
        return ESP_ERR_INVALID_STATE;
    }
    if (page >= OLED_SSD1306_PAGES || text == NULL) {
        return ESP_ERR_INVALID_ARG;
    }
    uint8_t data[OLED_SSD1306_WIDTH + 1] = {0x40};
    for (unsigned column = 0; column < OLED_SSD1306_TEXT_COLUMNS && text[column] != '\0'; ++column) {
        unsigned char c = (unsigned char)text[column];
        if (c < 0x20 || c > 0x7E) {
            c = '?';
        }
        memcpy(&data[1 + column * 6], font5x7[c - 0x20], 5);
    }
    return write_page(page, data);
}
